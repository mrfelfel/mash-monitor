## br_ext_lvgl/Config.in
```kconfig
menu "External LVGL support"

    menu "Graphic libraries"
        source "br_ext_lvgl/package/lvgl/Config.in"
    endmenu

endmenu
```

## br_ext_lvgl/package/lvgl/Config.in
```kconfig
config BR2_PACKAGE_LVGL
    bool "LVGL (Light and Versatile Graphics Library)"
    help
      LVGL is an embedded graphics library for microcontrollers and small Linux systems.
      https://lvgl.io
```
